## CMakeLists.txt
```
cmake_minimum_required(VERSION 3.20.0)
find_package(Zephyr REQUIRED HINTS $ENV{ZEPHYR_BASE})

project(extend_app)

target_sources(app PRIVATE src/main.c)

target_sources_ifdef(CONFIG_MYFUNCTION app PRIVATE src/myfunction.c)

#target_sources(app PRIVATE src/myfunction.c)
```

## prj.conf
```kconfig
CONFIG_MYFUNCTION=y
```

## src/main.c
```c
#include <zephyr/kernel.h>
#include <zephyr/sys/printk.h>

#include "myfunction.h"

int main(void)
{
        int val = 10;

        while (1)
        {
                for (int i = 0; i < 10; i++)
                {

#ifdef CONFIG_MYFUNCTION

                        printk("Sum: %d\r\n", sum(val, i));
#else
                        printk("MYFUNCTION not enabled\r\n");
                        return;
#endif

                }
                        k_msleep(2000);
        }



        return 0;
}
```
